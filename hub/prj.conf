## CMakeLists.txt
```
cmake_minimum_required(VERSION 3.20.0)

# The MG8 board definition is shared with the bring-up firmware one level up
list(APPEND BOARD_ROOT ${CMAKE_CURRENT_SOURCE_DIR}/..)

find_package(Zephyr REQUIRED HINTS $ENV{ZEPHYR_BASE})
project(mg8_hub)

target_sources(app PRIVATE
	src/main.c
	src/modem.c
	src/clock.c
	src/tag_format.c
	src/tag_client.c
	src/upload.c
	src/store.c
)
```

## Kconfig
```
# Exactcomms hub on the Minew MG8. Names and defaults follow the ESP32-S3 hub
# (exactcomms_esp32-s3-hub) where the setting exists there.

menu "MG8 hub"

config HUB_VERSION
	string "Firmware version reported in the status ping"
	default "mg8-0.1.0"

config HUB_TAG_NAME
	string "Advertised name of a tag ready to download"
	default "exactcomms_tag"
	help
	  As the ESP32 hub's sdkconfig and the tag firmware (TAG_DEVICE_NAME). The ESP32 hub's
	  Kconfig default, exactcomms_c10, is not what the tags use.

config HUB_TAG_MIN_RSSI
	int "Minimum tag RSSI to connect (dBm)"
	default -95

config HUB_LOG_NEARBY
	bool "Log every named or Eddystone BLE device once (debug)"
	default n
	help
	  Shows what nearby tags actually advertise. Turn on to debug tag discovery.

config HUB_LOG_RECORDS
	bool "Log every downloaded tag record (tag, beacon, RSSI, contact times)"
	default n
	help
	  Production servers only answer "HTTP/1.1 200 OK", so this is the only way to see on the
	  hub which beacons each tag reported.

config HUB_WATCH_ADDR_PREFIX
	string "Log raw advertising data of addresses starting with these, comma-separated (debug)"
	depends on HUB_LOG_NEARBY
	default ""
	help
	  "*" logs every device heard, once each, not only named or Eddystone ones.

config HUB_QUEUE_SIZE
	int "RAM upload queue length (items of up to 4 tag records)"
	default 80
	help
	  Each item is a fixed 1000 byte slot. With HUB_FLASH_QUEUE this only holds items on their
	  way into flash, and limits how many records one tag download can take; without it, it is
	  the whole queue. The ESP32 hub keeps 50 items (200 records) in RAM.

config HUB_FLASH_QUEUE
	bool "Keep the upload queue in the external W25Q64 flash"
	default y
	help
	  Uses the hub-queue partition (4 MB, about 16,000 records), kept through resets and LTE
	  outages. Without the flash the hub falls back to the RAM queue.

config HUB_SERVER_MAIN
	string "Main upload server (IP or host name)"
	default "tcpbin.com"
	help
	  Defaults to a public TCP echo server for testing. prod.conf sets the production servers.

config HUB_SERVER_AZ2
	string "First backup upload server"
	default "tcpbin.com"

config HUB_SERVER_AZ3
	string "Second backup upload server"
	default "tcpbin.com"

config HUB_SERVER_PORT
	int "Upload server TCP port"
	default 4242

config HUB_UPLOAD_APPEND_NEWLINE
	bool "Append a newline to every upload"
	default y
	help
	  A line-based echo server only answers (the ACK) once it sees a newline. The production
	  server does not need one; prod.conf turns this off.

config HUB_SERVER_MAX_RETRIES
	int "Failed uploads before switching to the next server"
	default 5

config HUB_MAIN_SERVER_RETRY_MIN
	int "Minutes on a backup server before trying the main one again"
	default 120

config HUB_ACK_TIMEOUT_S
	int "Seconds to wait for the server's reply to an upload"
	default 10

config HUB_STATUS_PING_MIN
	int "Status ping interval (minutes)"
	default 15

config HUB_APN
	string "LTE APN (empty = the SIM's default)"
	default ""

config HUB_NTP_SERVER
	string "NTP server used through the modem"
	default "pool.ntp.org"

endmenu

source "Kconfig.zephyr"
```

## prj.conf
```kconfig
# Exactcomms hub on the MG8. Board basics (RTT console, 32 kHz crystal, DC/DC off) come from
# boards/arm/mg8_nrf52840. Upload servers default to a test echo server; see Kconfig and prod.conf.

CONFIG_PRINTK=y
CONFIG_LOG=y
CONFIG_LOG_BACKEND_RTT=y
CONFIG_LOG_BACKEND_UART=n
CONFIG_LOG_BUFFER_SIZE=4096
CONFIG_SEGGER_RTT_BUFFER_SIZE_UP=8192
CONFIG_SEGGER_RTT_BUFFER_SIZE_DOWN=64

# Legacy APPROTECT on this AAD0 chip: only read UICR, never write it
CONFIG_NRF_APPROTECT_USE_UICR=y

CONFIG_MAIN_STACK_SIZE=6144
CONFIG_SYSTEM_WORKQUEUE_STACK_SIZE=2048
CONFIG_REBOOT=y

# Modem UART (uart1, enabled in app.overlay)
CONFIG_SERIAL=y
CONFIG_UART_INTERRUPT_DRIVEN=y
CONFIG_RING_BUFFER=y

# Upload queue in the W25Q64 external flash (SPIM2)
CONFIG_SPI=y
CONFIG_FLASH=y
CONFIG_SPI_NOR=y
CONFIG_SPI_NOR_SFDP_RUNTIME=y
CONFIG_FLASH_MAP=y
CONFIG_CRC=y

# BLE central: scan for C10 tags, connect, download over GATT notifications
CONFIG_BT=y
CONFIG_BT_CENTRAL=y
CONFIG_BT_OBSERVER=y
# Hub beacon that tells tags a hub is near
CONFIG_BT_BROADCASTER=y
CONFIG_BT_GATT_CLIENT=y
CONFIG_BT_GATT_AUTO_DISCOVER_CCC=y
CONFIG_BT_DEVICE_NAME="MG8-hub"
CONFIG_BT_MAX_CONN=1
# Tag data packets are up to 400 bytes in one notification, so ask for the same 500 byte MTU
# as the ESP32 hub
CONFIG_BT_L2CAP_TX_MTU=498
CONFIG_BT_BUF_ACL_RX_SIZE=502
CONFIG_BT_BUF_ACL_TX_SIZE=251
CONFIG_BT_CTLR_DATA_LENGTH_MAX=251
CONFIG_BT_GATT_DM=n
CONFIG_BT_RX_STACK_SIZE=4096
```

## prod.conf
```kconfig
# Production upload servers, same as the ESP32-S3 hub. Use only on purpose:
#   ..\build.ps1 -App hub -CMakeArgs '-DEXTRA_CONF_FILE=prod.conf'
CONFIG_HUB_SERVER_MAIN="52.51.154.7"
CONFIG_HUB_SERVER_AZ2="63.32.141.45"
CONFIG_HUB_SERVER_AZ3="54.220.218.5"
CONFIG_HUB_SERVER_PORT=9007
CONFIG_HUB_UPLOAD_APPEND_NEWLINE=n
```

## app.overlay
```dts
/* The hub talks to the modem through the Zephyr UART driver */
&uart1 {
	status = "okay";
};

/*
 * Upload queue in the first half of the W25Q64 (see src/store.c). The rest stays free, e.g. for an
 * MCUboot secondary slot. The bring-up firmware's !flash test uses the chip's last sector.
 */
&w25q64 {
	partitions {
		compatible = "fixed-partitions";
		#address-cells = <1>;
		#size-cells = <1>;

		hub_queue_partition: partition@0 {
			label = "hub-queue";
			reg = <0x00000000 0x00400000>;
		};
	};
};
```

## src/main.c
```c
/*
 * Exactcomms hub on the Minew MG8: downloads C10 tags over BLE and uploads their records over
 * LTE (Quectel EG916Q-GL), a port of the ESP32-S3 hub (exactcomms_esp32-s3-hub).
 *
 * The main thread owns the modem: power, registration, clock, uploads and the status ping.
 * BLE scanning and tag downloads run in the Bluetooth threads and only touch the upload queue.
 * Tag scanning starts once the clock is set, because every record carries a date.
 *
 * LED: red = no LTE, blue = tag connected, green = LTE up and last upload OK,
 *      yellow (red + green) = LTE up but the last upload failed.
 * Logs go to SEGGER RTT. tools/flash.ps1 shuts the modem down cleanly before flashing.
 */

#include <stdio.h>
#include <zephyr/kernel.h>
#include <zephyr/bluetooth/bluetooth.h>
#include <zephyr/logging/log.h>
#include <hal/nrf_gpio.h>
#include <nrf.h>

#include "clock.h"
#include "modem.h"
#include "tag_client.h"
#include "upload.h"

LOG_MODULE_REGISTER(main, LOG_LEVEL_INF);

/* The MG8 has no DC/DC inductors: either converter browns the chip out in a loop */
#if defined(CONFIG_SOC_DCDC_NRF52X) || defined(CONFIG_SOC_DCDC_NRF52X_HV)
#error "DC/DC must stay off on the MG8 (build for board mg8_nrf52840)"
#endif

#define LED_RED	  NRF_GPIO_PIN_MAP(0, 8)
#define LED_GREEN NRF_GPIO_PIN_MAP(0, 6)
#define LED_BLUE  NRF_GPIO_PIN_MAP(0, 12)

#define NETWORK_CHECK_MS     10000
#define NETWORK_RECHECK_MS   60000
#define NETWORK_LOST_RESTART (5 * 60 * 1000)
#define NETWORK_LOG_MS	     60000
#define POWER_RETRY_MS	     30000
#define TIME_RESYNC_MS	     (6 * 3600 * 1000LL)
#define TIME_RETRY_MS	     60000

static void led_set(bool red, bool green, bool blue)
{
	nrf_gpio_pin_write(LED_RED, !red);
	nrf_gpio_pin_write(LED_GREEN, !green);
	nrf_gpio_pin_write(LED_BLUE, !blue);
}

static void leds_init(void)
{
	nrf_gpio_pin_set(LED_RED);
	nrf_gpio_pin_set(LED_GREEN);
	nrf_gpio_pin_set(LED_BLUE);
	nrf_gpio_cfg_output(LED_RED);
	nrf_gpio_cfg_output(LED_GREEN);
	nrf_gpio_cfg_output(LED_BLUE);
}

/*
 * REGOUT0 must be 3.0 V (the erased default 1.8 V is too low for the LEDs and flash).
 * APPROTECT is never touched: on this AAD0 chip any value other than 0xFF locks it.
 */
static void uicr_setup(void)
{
	uint32_t want = (NRF_UICR->REGOUT0 & ~UICR_REGOUT0_VOUT_Msk) |
			(UICR_REGOUT0_VOUT_3V0 << UICR_REGOUT0_VOUT_Pos);

	if (NRF_UICR->REGOUT0 == want) {
		return;
	}
	NRF_NVMC->CONFIG = NVMC_CONFIG_WEN_Wen;
	while (!NRF_NVMC->READY) {
	}
	NRF_UICR->REGOUT0 = want;
	while (!NRF_NVMC->READY) {
	}
	NRF_NVMC->CONFIG = NVMC_CONFIG_WEN_Ren;
	while (!NRF_NVMC->READY) {
	}
	NVIC_SystemReset();
}

static void set_hub_id(void)
{
	bt_addr_le_t addr;
	size_t count = 1;
	char mac[18];

	bt_id_get(&addr, &count);
	snprintf(mac, sizeof(mac), "%02x:%02x:%02x:%02x:%02x:%02x", addr.a.val[5], addr.a.val[4],
		 addr.a.val[3], addr.a.val[2], addr.a.val[1], addr.a.val[0]);
	upload_set_hub_id(mac);
	LOG_INF("Hub ID (BLE address) %s", mac);
}

int main(void)
{
	uicr_setup();
	leds_init();
	led_set(true, false, false);

	uint32_t resetreas = NRF_POWER->RESETREAS;

	NRF_POWER->RESETREAS = resetreas;
	NRF_POWER->GPREGRET2 = 0;
	upload_set_reset_reason(resetreas);
	upload_init();

	LOG_INF("MG8 hub %s, RESETREAS 0x%08x, DCDCEN %u/%u", CONFIG_HUB_VERSION, resetreas,
		NRF_POWER->DCDCEN, NRF_POWER->DCDCEN0);
	LOG_INF("Upload servers %s / %s / %s port %d%s", CONFIG_HUB_SERVER_MAIN,
		CONFIG_HUB_SERVER_AZ2, CONFIG_HUB_SERVER_AZ3, CONFIG_HUB_SERVER_PORT,
		IS_ENABLED(CONFIG_HUB_UPLOAD_APPEND_NEWLINE) ? " (newline appended, test mode)" : "");

	int err = bt_enable(NULL);

	if (err) {
		LOG_ERR("bt_enable failed: %d", err);
	} else {
		set_hub_id();
	}

	if (modem_init() != 0) {
		led_set(true, false, false);
		return 0;
	}

	bool network_ok = false;
	int64_t last_power_try = -POWER_RETRY_MS;
	int64_t last_network_check = -NETWORK_CHECK_MS;
	int64_t network_lost_since = k_uptime_get();
	int64_t last_network_log = 0;
	int64_t last_time_sync = 0;
	int64_t last_time_try = -TIME_RETRY_MS;
	int64_t last_ping = 0;

	for (;;) {
		int64_t now = k_uptime_get();

		if (modem_check_shutdown_request()) {
			/* Flashing or a debugger reset follows; stay quiet until then */
			led_set(false, false, false);
			for (;;) {
				k_sleep(K_FOREVER);
			}
		}

		if (!modem_is_on()) {
			network_ok = false;
			if (now - last_power_try >= POWER_RETRY_MS) {
				last_power_try = now;
				if (modem_power_on() != 0) {
					modem_power_off();
				}
				network_lost_since = k_uptime_get();
			}
			k_msleep(100);
			continue;
		}

		if (modem_is_stuck()) {
			LOG_WRN("Modem stopped answering, power-cycling it");
			modem_power_off();
			continue;
		}

		/* Registration and PDP context: often while down, once a minute while up */
		if (now - last_network_check >= (network_ok ? NETWORK_RECHECK_MS : NETWORK_CHECK_MS)) {
			last_network_check = now;
			bool ok = modem_network_ready();

			if (ok && !network_ok) {
				LOG_INF("LTE up, signal %d dBm", modem_signal_dbm());
			} else if (!ok && network_ok) {
				LOG_WRN("LTE lost");
				network_lost_since = now;
			} else if (!ok && now - network_lost_since > NETWORK_LOST_RESTART) {
				LOG_WRN("No LTE for %d min, power-cycling the modem",
					NETWORK_LOST_RESTART / 60000);
				modem_power_off();
				continue;
			}
			if (!ok && now - last_network_log >= NETWORK_LOG_MS) {
				last_network_log = now;
				modem_log_network_state();
			}
			network_ok = ok;
		}

		if (network_ok) {
			if ((!clock_is_set() || now - last_time_sync > TIME_RESYNC_MS) &&
			    now - last_time_try >= TIME_RETRY_MS) {
				last_time_try = now;
				if (modem_sync_time() == 0) {
					last_time_sync = now;
				}
			}
			if (clock_is_set()) {
				tag_client_start();

				/* First ping right away so a new hub shows up, then periodically */
				if (last_ping == 0 ||
				    now - last_ping >= CONFIG_HUB_STATUS_PING_MIN * 60 * 1000LL) {
					last_ping = now;
					upload_queue_status_ping(modem_signal_dbm());
				}
			}
			upload_process();
		}

		if (tag_client_busy()) {
			led_set(false, false, true);
		} else if (!network_ok) {
			led_set(true, false, false);
		} else {
			led_set(!upload_last_sync_ok(), true, false);
		}
		k_msleep(100);
	}
	return 0;
}
```

## src/clock.c
```c
#include <stdio.h>
#include <zephyr/kernel.h>

#include "clock.h"

static int64_t base_epoch_s;
static int64_t base_uptime_ms;
static bool is_set;

void clock_set_utc(int64_t epoch_s)
{
	base_uptime_ms = k_uptime_get();
	base_epoch_s = epoch_s;
	is_set = true;
}

bool clock_is_set(void)
{
	return is_set;
}

int64_t clock_now_utc(void)
{
	return base_epoch_s + (k_uptime_get() - base_uptime_ms) / 1000;
}

/* Days since 1970-01-01 for a proleptic Gregorian date (Howard Hinnant's days_from_civil) */
static int64_t days_from_civil(int y, int m, int d)
{
	y -= m <= 2;
	int64_t era = (y >= 0 ? y : y - 399) / 400;
	int64_t yoe = y - era * 400;
	int64_t doy = (153 * (m + (m > 2 ? -3 : 9)) + 2) / 5 + d - 1;
	int64_t doe = yoe * 365 + yoe / 4 - yoe / 100 + doy;

	return era * 146097 + doe - 719468;
}

int64_t clock_epoch_from_civil(int year, int month, int day, int hour, int min, int sec)
{
	return days_from_civil(year, month, day) * 86400 + hour * 3600 + min * 60 + sec;
}

void clock_format_datetime(int64_t epoch_s, char *buf, size_t len)
{
	int64_t days = epoch_s / 86400;
	int64_t rem = epoch_s % 86400;

	if (rem < 0) {
		rem += 86400;
		days--;
	}

	/* civil_from_days */
	days += 719468;
	int64_t era = (days >= 0 ? days : days - 146096) / 146097;
	int64_t doe = days - era * 146097;
	int64_t yoe = (doe - doe / 1460 + doe / 36524 - doe / 146096) / 365;
	int64_t doy = doe - (365 * yoe + yoe / 4 - yoe / 100);
	int64_t mp = (5 * doy + 2) / 153;
	int d = (int)(doy - (153 * mp + 2) / 5 + 1);
	int m = (int)(mp < 10 ? mp + 3 : mp - 9);
	int y = (int)(yoe + era * 400 + (m <= 2));

	snprintf(buf, len, "%04d-%02d-%02d %02d:%02d:%02d", y, m, d, (int)(rem / 3600),
		 (int)(rem / 60 % 60), (int)(rem % 60));
}
```

## src/clock.h
```c
/* Wall clock for the hub: set once from the modem (NTP), then kept from the uptime counter */

#pragma once

#include <stdbool.h>
#include <stddef.h>
#include <stdint.h>

void clock_set_utc(int64_t epoch_s);
bool clock_is_set(void);
int64_t clock_now_utc(void);

/* "YYYY-mm-dd HH:MM:SS" (UTC) for an epoch, like the ESP32 hub with TZ=UTC. buf >= 20 bytes. */
void clock_format_datetime(int64_t epoch_s, char *buf, size_t len);

/* Epoch for a civil UTC date and time */
int64_t clock_epoch_from_civil(int year, int month, int day, int hour, int min, int sec);
```

## src/modem.c
```c
#include <errno.h>
#include <stdio.h>
#include <stdlib.h>
#include <string.h>
#include <zephyr/kernel.h>
#include <zephyr/device.h>
#include <zephyr/drivers/uart.h>
#include <zephyr/logging/log.h>
#include <zephyr/sys/ring_buffer.h>
#include <hal/nrf_gpio.h>
#include <nrf.h>

#include "clock.h"
#include "modem.h"

LOG_MODULE_REGISTER(modem, LOG_LEVEL_INF);

/* Modem control pins, see README.md. Each drives an N-MOSFET or the buck enable: high = active. */
#define MODEM_PWR_EN	NRF_GPIO_PIN_MAP(1, 9)
#define MODEM_PWRKEY	NRF_GPIO_PIN_MAP(0, 15)
#define MODEM_RESET	NRF_GPIO_PIN_MAP(0, 13)
#define MODEM_W_DISABLE NRF_GPIO_PIN_MAP(0, 31)
#define MODEM_DTR	NRF_GPIO_PIN_MAP(0, 16)
#define MODEM_RTS	NRF_GPIO_PIN_MAP(0, 24)

#define PWRKEY_PULSE_MS	 1000
#define BOOT_TIMEOUT_S	 20
#define QISEND_MAX	 1460
#define SHUTDOWN_REQUEST 0xA5
#define SHUTDOWN_DONE	 0x5A

static const struct device *const uart = DEVICE_DT_GET(DT_NODELABEL(uart1));

RING_BUF_DECLARE(rx_ring, 2048);
static K_SEM_DEFINE(rx_sem, 0, 1);

/* Asynchronous results that can arrive while another command runs */
#define URC_SLOTS 4
static char urc_store[URC_SLOTS][128];

static char line[600];
static char resp[1024];
static bool socket_closed;

/* AT commands that timed out in a row: the modem can answer AT yet hang on everything else */
static int timeouts_in_row;

static void uart_isr(const struct device *dev, void *user_data)
{
	uint8_t buf[32];

	if (!uart_irq_update(dev)) {
		return;
	}
	while (uart_irq_rx_ready(dev)) {
		int n = uart_fifo_read(dev, buf, sizeof(buf));

		if (n <= 0) {
			break;
		}
		ring_buf_put(&rx_ring, buf, n);
		k_sem_give(&rx_sem);
	}
}

static int get_char(int64_t deadline)
{
	for (;;) {
		uint8_t c;
		unsigned int key = irq_lock();
		uint32_t n = ring_buf_get(&rx_ring, &c, 1);

		irq_unlock(key);
		if (n == 1) {
			return c;
		}
		int64_t left = deadline - k_uptime_get();

		if (left <= 0) {
			return -ETIMEDOUT;
		}
		k_sem_take(&rx_sem, K_MSEC(left));
	}
}

/* One non-empty line without CR/LF, or -ETIMEDOUT */
static int read_line(char *buf, size_t len, int64_t deadline)
{
	size_t n = 0;

	for (;;) {
		int c = get_char(deadline);

		if (c < 0) {
			return c;
		}
		if (c == '\r') {
			continue;
		}
		if (c == '\n') {
			if (n == 0) {
				continue;
			}
			buf[n] = '\0';
			return n;
		}
		if (n < len - 1) {
			buf[n++] = (char)c;
		}
	}
}

static void write_str(const char *s, size_t len)
{
	for (size_t i = 0; i < len; i++) {
		uart_poll_out(uart, s[i]);
	}
}

static bool is_async(const char *l)
{
	return strncmp(l, "+QIOPEN:", 8) == 0 || strncmp(l, "+QIURC:", 7) == 0 ||
	       strncmp(l, "+QNTP:", 6) == 0;
}

static void handle_async(const char *l)
{
	if (strncmp(l, "+QIURC: \"closed\"", 16) == 0) {
		socket_closed = true;
	}
	if (strncmp(l, "+QIURC: \"recv\"", 14) == 0) {
		return;
	}
	for (int i = 0; i < URC_SLOTS; i++) {
		if (urc_store[i][0] == '\0') {
			strncpy(urc_store[i], l, sizeof(urc_store[i]) - 1);
			return;
		}
	}
	LOG_WRN("URC store full, dropping: %s", l);
}

/* Takes a stored asynchronous line starting with prefix, if any */
static bool take_urc(const char *prefix, char *out, size_t len)
{
	for (int i = 0; i < URC_SLOTS; i++) {
		if (urc_store[i][0] != '\0' && strncmp(urc_store[i], prefix, strlen(prefix)) == 0) {
			strncpy(out, urc_store[i], len - 1);
			out[len - 1] = '\0';
			urc_store[i][0] = '\0';
			return true;
		}
	}
	return false;
}

static void clear_urcs(const char *prefix)
{
	char tmp[128];

	while (take_urc(prefix, tmp, sizeof(tmp))) {
	}
}

/* Reads whatever arrived between commands: URCs and stray lines */
static void drain(void)
{
	while (read_line(line, sizeof(line), k_uptime_get()) > 0) {
		if (is_async(line)) {
			handle_async(line);
		} else {
			LOG_DBG("unsolicited: %s", line);
		}
	}
}

/*
 * Sends cmd and collects the response lines (without the final OK) into resp.
 * Returns 0 on OK, -EIO on ERROR, -ETIMEDOUT.
 */
static int at_cmd(const char *cmd, int timeout_ms)
{
	int64_t deadline = k_uptime_get() + timeout_ms;
	size_t used = 0;

	drain();
	resp[0] = '\0';
	write_str(cmd, strlen(cmd));
	write_str("\r", 1);

	while (read_line(line, sizeof(line), deadline) > 0) {
		if (strcmp(line, "OK") == 0) {
			timeouts_in_row = 0;
			return 0;
		}
		if (strcmp(line, "ERROR") == 0 || strncmp(line, "+CME ERROR", 10) == 0) {
			timeouts_in_row = 0;
			LOG_WRN("%s -> %s", cmd, line);
			return -EIO;
		}
		if (is_async(line)) {
			handle_async(line);
			continue;
		}
		if (strcmp(line, cmd) == 0) {
			continue; /* echo, before ATE0 */
		}
		used += snprintf(resp + used, sizeof(resp) - used, "%s\n", line);
		if (used >= sizeof(resp)) {
			used = sizeof(resp) - 1;
		}
	}
	timeouts_in_row++;
	LOG_WRN("%s -> timeout", cmd);
	return -ETIMEDOUT;
}

/* Waits for an asynchronous line with the given prefix (stored or new) */
static int wait_urc(const char *prefix, char *out, size_t len, int timeout_ms)
{
	int64_t deadline = k_uptime_get() + timeout_ms;

	for (;;) {
		if (take_urc(prefix, out, len)) {
			return 0;
		}
		if (read_line(line, sizeof(line), deadline) < 0) {
			return -ETIMEDOUT;
		}
		if (is_async(line)) {
			handle_async(line);
		}
	}
}

static void output_low(uint32_t pin)
{
	nrf_gpio_pin_clear(pin);
	nrf_gpio_cfg_output(pin);
}

int modem_init(void)
{
	/* Modem off, PWRKEY released, not in reset, not in airplane mode, DTR/RTS asserted */
	output_low(MODEM_PWR_EN);
	output_low(MODEM_PWRKEY);
	output_low(MODEM_RESET);
	output_low(MODEM_W_DISABLE);
	output_low(MODEM_DTR);
	output_low(MODEM_RTS);

	if (!device_is_ready(uart)) {
		LOG_ERR("uart1 not ready");
		return -ENODEV;
	}
	uart_irq_callback_user_data_set(uart, uart_isr, NULL);
	uart_irq_rx_enable(uart);
	return 0;
}

bool modem_is_on(void)
{
	return nrf_gpio_pin_out_read(MODEM_PWR_EN);
}

int modem_power_on(void)
{
	LOG_INF("Powering the modem up");
	nrf_gpio_pin_set(MODEM_PWR_EN);
	k_msleep(100);
	nrf_gpio_pin_set(MODEM_PWRKEY);
	k_msleep(PWRKEY_PULSE_MS);
	nrf_gpio_pin_clear(MODEM_PWRKEY);

	for (int s = 0; s < BOOT_TIMEOUT_S; s++) {
		if (at_cmd("AT", 500) == 0) {
			LOG_INF("Modem answered after %d s", s + 1);
			at_cmd("ATE0", 500);
			at_cmd("AT+CMEE=2", 500);
			if (at_cmd("ATI", 1000) == 0) {
				LOG_INF("%s", resp);
			}
			if (strlen(CONFIG_HUB_APN) > 0) {
				char cmd[96];

				snprintf(cmd, sizeof(cmd), "AT+QICSGP=1,1,\"%s\",\"\",\"\",1",
					 CONFIG_HUB_APN);
				at_cmd(cmd, 1000);
			}
			return 0;
		}
		k_msleep(500);
	}
	LOG_ERR("Modem did not answer within %d s", BOOT_TIMEOUT_S);
	return -ETIMEDOUT;
}

void modem_power_off(void)
{
	/* Cutting the supply under a running modem can corrupt its file system */
	if (modem_is_on() && at_cmd("AT", 500) == 0) {
		LOG_INF("Shutting the modem down (AT+QPOWD)");
		at_cmd("AT+QPOWD=1", 2000);
		k_msleep(3000);
	}
	nrf_gpio_pin_clear(MODEM_PWRKEY);
	nrf_gpio_pin_clear(MODEM_PWR_EN);
	socket_closed = true;
	timeouts_in_row = 0;
}

bool modem_is_stuck(void)
{
	return timeouts_in_row >= 3;
}

static int cereg_status(void)
{
	if (at_cmd("AT+CEREG?", 1000) != 0) {
		return -1;
	}
	char *p = strstr(resp, "+CEREG:");
	char *comma = (p != NULL) ? strchr(p, ',') : NULL;

	return (comma != NULL) ? atoi(comma + 1) : -1;
}

bool modem_network_ready(void)
{
	int stat = cereg_status();

	if (stat != 1 && stat != 5) {
		return false;
	}
	if (at_cmd("AT+QIACT?", 2000) == 0 && strstr(resp, "+QIACT: 1,1") != NULL) {
		return true;
	}
	LOG_INF("Activating the PDP context");
	if (at_cmd("AT+QIACT=1", 150000) != 0) {
		return false;
	}
	return at_cmd("AT+QIACT?", 2000) == 0 && strstr(resp, "+QIACT: 1,1") != NULL;
}

void modem_log_network_state(void)
{
	static const char *const cmds[] = {"AT+CPIN?", "AT+CSQ", "AT+CEREG?", "AT+QNWINFO",
					   "AT+COPS?", "AT+CEER"};
	char state[384];
	size_t used = 0;

	state[0] = '\0';
	for (size_t i = 0; i < ARRAY_SIZE(cmds) && used < sizeof(state); i++) {
		int err = at_cmd(cmds[i], 2000);
		char *nl = strchr(resp, '\n');

		if (nl != NULL) {
			*nl = '\0';
		}
		used += snprintf(state + used, sizeof(state) - used, "%s%s", i > 0 ? ", " : "",
				 err == 0 ? resp : "error");
	}
	LOG_INF("Network: %s", state);
}

int modem_signal_dbm(void)
{
	if (at_cmd("AT+CSQ", 1000) != 0) {
		return 0;
	}
	char *p = strstr(resp, "+CSQ:");
	int rssi = (p != NULL) ? atoi(p + 5) : 99;

	return (rssi >= 0 && rssi <= 31) ? -113 + 2 * rssi : 0;
}

/* "yyyy/MM/dd,hh:mm:ss+zz" (zz = quarter hours, year may be two digits) to UTC epoch */
static int64_t parse_modem_time(const char *s)
{
	int y, mo, d, h, mi, sec, tz = 0;
	char sign = '+';
	const char *q = strchr(s, '"');

	if (q == NULL || sscanf(q + 1, "%d/%d/%d,%d:%d:%d%c%d", &y, &mo, &d, &h, &mi, &sec, &sign,
				&tz) < 6) {
		return -1;
	}
	/* An unset modem clock reads "70/01/01": two-digit years from 70 are 19xx */
	if (y < 70) {
		y += 2000;
	} else if (y < 100) {
		y += 1900;
	}
	if (y < 2024) {
		LOG_WRN("Modem clock not set (%s)", s);
		return -1;
	}
	int64_t epoch = clock_epoch_from_civil(y, mo, d, h, mi, sec);
	int64_t offset = (int64_t)tz * 15 * 60;

	return (sign == '-') ? epoch + offset : epoch - offset;
}

int modem_sync_time(void)
{
	char cmd[96];
	char urc[128];
	int64_t epoch = -1;

	clear_urcs("+QNTP:");
	snprintf(cmd, sizeof(cmd), "AT+QNTP=1,\"%s\",123", CONFIG_HUB_NTP_SERVER);
	if (at_cmd(cmd, 5000) == 0 && wait_urc("+QNTP:", urc, sizeof(urc), 70000) == 0) {
		LOG_INF("NTP: %s", urc);
		if (atoi(urc + 6) == 0) {
			epoch = parse_modem_time(urc);
		} else {
			LOG_WRN("NTP failed: %s", urc);
		}
	}
	if (epoch < 0 && at_cmd("AT+CCLK?", 1000) == 0) {
		LOG_INF("NTP unavailable, using the network time: %s", resp);
		epoch = parse_modem_time(resp);
	}
	if (epoch < 0) {
		return -EAGAIN;
	}
	clock_set_utc(epoch);

	char now[24];

	clock_format_datetime(epoch, now, sizeof(now));
	LOG_INF("Clock set: %s UTC", now);
	return 0;
}

int modem_tcp_open(const char *host, uint16_t port)
{
	char cmd[128];
	char urc[64];

	at_cmd("AT+QICLOSE=0", 10000);
	clear_urcs("+QIOPEN:");
	clear_urcs("+QIURC:");
	socket_closed = false;

	snprintf(cmd, sizeof(cmd), "AT+QIOPEN=1,0,\"TCP\",\"%s\",%u,0,0", host, port);
	if (at_cmd(cmd, 5000) != 0) {
		return -EIO;
	}
	if (wait_urc("+QIOPEN: 0,", urc, sizeof(urc), 60000) != 0) {
		LOG_WRN("No +QIOPEN result for %s:%u", host, port);
		return -ETIMEDOUT;
	}
	int err = atoi(urc + 11);

	if (err != 0) {
		LOG_WRN("Connecting to %s:%u failed, error %d", host, port, err);
		return -ECONNREFUSED;
	}
	return 0;
}

static int send_chunk(const char *data, size_t len)
{
	char cmd[32];
	int64_t deadline = k_uptime_get() + 5000;
	size_t n = 0;

	drain();
	snprintf(cmd, sizeof(cmd), "AT+QISEND=0,%u\r", len);
	write_str(cmd, strlen(cmd));

	/* The modem answers with a "> " prompt (no newline) when it is ready for the data */
	for (;;) {
		int c = get_char(deadline);

		if (c < 0) {
			return -ETIMEDOUT;
		}
		if (c == '>') {
			break;
		}
		if (c == '\n') {
			line[n] = '\0';
			if (strstr(line, "ERROR") != NULL) {
				LOG_WRN("QISEND refused: %s", line);
				return -EIO;
			}
			n = 0;
		} else if (c != '\r' && n < sizeof(line) - 1) {
			line[n++] = (char)c;
		}
	}
	write_str(data, len);

	deadline = k_uptime_get() + 10000;
	while (read_line(line, sizeof(line), deadline) > 0) {
		if (strcmp(line, "SEND OK") == 0) {
			return 0;
		}
		if (strcmp(line, "SEND FAIL") == 0 || strstr(line, "ERROR") != NULL) {
			LOG_WRN("Send failed: %s", line);
			return -EIO;
		}
		if (is_async(line)) {
			handle_async(line);
		}
	}
	return -ETIMEDOUT;
}

int modem_tcp_send(const void *data, size_t len)
{
	const char *p = data;

	while (len > 0) {
		size_t chunk = MIN(len, QISEND_MAX);
		int err = send_chunk(p, chunk);

		if (err) {
			return err;
		}
		p += chunk;
		len -= chunk;
	}
	return 0;
}

/* Socket 0's state from AT+QISTATE (2 = connected), or -1 if the modem lists no socket 0 */
static int socket_state(void)
{
	if (at_cmd("AT+QISTATE=1,0", 1000) != 0) {
		return -1;
	}
	char *p = strstr(resp, "+QISTATE: 0,");

	/* +QISTATE: 0,"TCP","<ip>",<port>,<local port>,<state>,... */
	for (int commas = 0; p != NULL && commas < 5; commas++) {
		p = strchr(p + 1, ',');
	}
	return (p != NULL) ? atoi(p + 1) : -1;
}

/*
 * A server that closes right after replying makes the modem report "closed" late, sometimes
 * after the next connection is already open. Only trust the flag if the socket really is down.
 */
static bool socket_really_closed(void)
{
	int state = socket_state();

	if (state == 2) {
		LOG_INF("Ignoring a stale \"closed\" report, the socket is connected");
		socket_closed = false;
		return false;
	}
	return true;
}

int modem_tcp_wait_reply(int timeout_ms)
{
	int64_t deadline = k_uptime_get() + timeout_ms;

	do {
		if (at_cmd("AT+QIRD=0,1500", 2000) == 0) {
			char *p = strstr(resp, "+QIRD:");
			int n = (p != NULL) ? atoi(p + 6) : 0;

			if (n > 0) {
				char *data = strchr(p, '\n');

				LOG_INF("Server replied %d bytes: %.40s", n, data != NULL ? data + 1 : "");
				return n;
			}
		}
		if (socket_closed && socket_really_closed()) {
			return -ENOTCONN;
		}
		k_msleep(300);
	} while (k_uptime_get() < deadline);
	return 0;
}

void modem_tcp_close(void)
{
	at_cmd("AT+QICLOSE=0", 10000);
	socket_closed = true;
}

bool modem_check_shutdown_request(void)
{
	if (NRF_POWER->GPREGRET2 != SHUTDOWN_REQUEST) {
		return false;
	}
	LOG_INF("Debugger asked for a modem shutdown");
	modem_power_off();
	NRF_POWER->GPREGRET2 = SHUTDOWN_DONE;
	return true;
}
```

## src/modem.h
```c
/*
 * Quectel EG916Q-GL on the MG8: power control, AT commands over uart1, network registration,
 * time and one TCP socket through the modem's own IP stack (AT+QIOPEN / QISEND / QIRD).
 * All calls block and are serialised; call them from one thread.
 */

#pragma once

#include <stdbool.h>
#include <stddef.h>
#include <stdint.h>

int modem_init(void);

/* Powers the modem up (3.8 V on, PWRKEY pulse) and waits for AT. 0 or -ETIMEDOUT. */
int modem_power_on(void);

/* AT+QPOWD if the modem answers, then switches its supply off */
void modem_power_off(void);

bool modem_is_on(void);

/* Three AT commands in a row timed out: the modem needs a power cycle */
bool modem_is_stuck(void);

/* Registered (home or roaming) and the PDP context is active. Activates the context if needed. */
bool modem_network_ready(void);

/* Logs SIM state, signal, registration and operator, to see why LTE does not come up */
void modem_log_network_state(void);

/* Signal in dBm from AT+CSQ, or 0 if unknown */
int modem_signal_dbm(void);

/* Gets UTC from NTP (or the network time as a fallback) and sets the hub clock. 0 on success. */
int modem_sync_time(void);

/* TCP socket 0 */
int modem_tcp_open(const char *host, uint16_t port);
int modem_tcp_send(const void *data, size_t len);
/* Waits for any reply. Returns the number of bytes, 0 on timeout, -ENOTCONN if closed. */
int modem_tcp_wait_reply(int timeout_ms);
void modem_tcp_close(void);

/*
 * Debugger mailbox (GPREGRET2), same as the bring-up firmware: 0xA5 = shut the modem down,
 * answered with 0x5A. Call regularly; returns true once a shutdown has been done.
 */
bool modem_check_shutdown_request(void);
```

## src/store.c
```c
/*
 * The hub-queue partition is a ring of 1 KB slots, four per 4 KB erase sector. A slot holds a
 * header and one item. Items are written in order with a rising sequence number. An uploaded item
 * is marked by programming its "done" word to 0, which NOR flash allows without an erase. A
 * sector is erased just before the ring enters it, and only when none of its items still waits,
 * so the waiting items always run contiguously from the tail to the head.
 *
 * At boot the headers give the oldest waiting item (tail) and the slot after the newest (head).
 * A write cut short by a reset leaves an invalid header, which is skipped.
 */

#include <errno.h>
#include <stddef.h>
#include <string.h>
#include <zephyr/kernel.h>
#include <zephyr/logging/log.h>
#include <zephyr/storage/flash_map.h>
#include <zephyr/sys/crc.h>

#include "store.h"
#include "tag_format.h"

LOG_MODULE_REGISTER(store, LOG_LEVEL_INF);

#define SLOT_SIZE	 1024
#define SECTOR_SIZE	 4096
#define SLOTS_PER_SECTOR (SECTOR_SIZE / SLOT_SIZE)
#define SLOT_MAGIC	 0x51425548 /* "HUBQ" */
#define WAITING		 0xffffffff

struct slot_header {
	uint32_t magic;
	uint32_t seq;
	uint32_t crc;
	uint16_t len;
	uint16_t reserved;
	uint32_t done; /* WAITING until uploaded, then 0 */
};

BUILD_ASSERT(sizeof(struct slot_header) + TAG_QUEUE_ITEM_SIZE <= SLOT_SIZE);

static const struct flash_area *fa;
static K_MUTEX_DEFINE(lock);
static uint32_t slot_count;
static uint32_t head;
static uint32_t tail;
static uint32_t next_seq = 1;
static uint32_t waiting;

static uint32_t next_slot(uint32_t slot)
{
	return (slot + 1) % slot_count;
}

static int read_header(uint32_t slot, struct slot_header *h)
{
	return flash_area_read(fa, slot * SLOT_SIZE, h, sizeof(*h));
}

static bool header_valid(const struct slot_header *h)
{
	return h->magic == SLOT_MAGIC && h->len > 0 && h->len < TAG_QUEUE_ITEM_SIZE;
}

static bool slot_blank(uint32_t slot)
{
	uint32_t buf[16];

	for (size_t off = 0; off < SLOT_SIZE; off += sizeof(buf)) {
		if (flash_area_read(fa, slot * SLOT_SIZE + off, buf, sizeof(buf)) != 0) {
			return false;
		}
		for (size_t i = 0; i < ARRAY_SIZE(buf); i++) {
			if (buf[i] != 0xffffffff) {
				return false;
			}
		}
	}
	return true;
}

static void mark_done(uint32_t slot)
{
	uint32_t zero = 0;

	if (flash_area_write(fa, slot * SLOT_SIZE + offsetof(struct slot_header, done), &zero,
			     sizeof(zero)) != 0) {
		/* It will be uploaded again after a reset: a duplicate, not a loss */
		LOG_WRN("Could not mark slot %u as uploaded", slot);
	}
}

int store_init(void)
{
	int err = flash_area_open(FIXED_PARTITION_ID(hub_queue_partition), &fa);

	if (err) {
		LOG_ERR("No hub-queue partition (%d)", err);
		return err;
	}
	if (!device_is_ready(fa->fa_dev)) {
		LOG_ERR("External flash not ready");
		return -ENODEV;
	}
	slot_count = fa->fa_size / SLOT_SIZE;

	bool any = false;
	bool any_waiting = false;
	uint32_t newest = 0;
	uint32_t oldest_waiting = 0;
	int64_t start = k_uptime_get();

	for (uint32_t slot = 0; slot < slot_count; slot++) {
		struct slot_header h;

		if (read_header(slot, &h) != 0) {
			LOG_ERR("Reading slot %u failed", slot);
			return -EIO;
		}
		if (!header_valid(&h)) {
			continue;
		}
		if (!any || h.seq > newest) {
			any = true;
			newest = h.seq;
			head = next_slot(slot);
		}
		if (h.done == WAITING) {
			waiting++;
			if (!any_waiting || h.seq < oldest_waiting) {
				any_waiting = true;
				oldest_waiting = h.seq;
				tail = slot;
			}
		}
	}
	if (any) {
		next_seq = newest + 1;
	}

	/* A write cut short by a reset can leave the rest of the head's sector dirty */
	for (uint32_t slot = head; slot % SLOTS_PER_SECTOR != 0; slot = next_slot(slot)) {
		if (!slot_blank(slot)) {
			LOG_WRN("Slot %u is not blank, starting at the next sector", slot);
			head = ROUND_UP(head + 1, SLOTS_PER_SECTOR) % slot_count;
			break;
		}
	}
	if (!any_waiting) {
		tail = head;
	}

	LOG_INF("Flash queue: %u KB, %u slots, %u items waiting (scan %lld ms)", fa->fa_size / 1024,
		slot_count, waiting, k_uptime_get() - start);
	return 0;
}

int store_put(const char *item)
{
	size_t len = strnlen(item, TAG_QUEUE_ITEM_SIZE - 1);
	int err = 0;

	if (len == 0) {
		return 0;
	}
	k_mutex_lock(&lock, K_FOREVER);

	if (head % SLOTS_PER_SECTOR == 0) {
		uint32_t sector = head / SLOTS_PER_SECTOR;

		if (waiting > 0 && tail / SLOTS_PER_SECTOR == sector) {
			k_mutex_unlock(&lock);
			return -ENOMEM;
		}
		err = flash_area_erase(fa, sector * SECTOR_SIZE, SECTOR_SIZE);
		if (err) {
			LOG_ERR("Erasing sector %u failed (%d)", sector, err);
			k_mutex_unlock(&lock);
			return -EIO;
		}
	}

	struct slot_header h = {
		.magic = SLOT_MAGIC,
		.seq = next_seq,
		.crc = crc32_ieee((const uint8_t *)item, len),
		.len = len,
		.reserved = 0xffff,
		.done = WAITING,
	};
	uint32_t slot = head;

	/* The header goes last, so a slot cut short by a reset never looks valid */
	err = flash_area_write(fa, slot * SLOT_SIZE + sizeof(h), item, len);
	if (err == 0) {
		err = flash_area_write(fa, slot * SLOT_SIZE, &h, sizeof(h));
	}

	/* Never write into a slot twice without an erase, even after a failed write */
	head = next_slot(head);
	if (err) {
		LOG_ERR("Writing slot %u failed (%d)", slot, err);
		k_mutex_unlock(&lock);
		return -EIO;
	}
	if (waiting == 0) {
		tail = slot;
	}
	waiting++;
	next_seq++;
	k_mutex_unlock(&lock);
	return 0;
}

int store_peek(char *buf, size_t len)
{
	k_mutex_lock(&lock, K_FOREVER);

	while (waiting > 0 && tail != head) {
		struct slot_header h;

		if (read_header(tail, &h) != 0) {
			k_mutex_unlock(&lock);
			return -EIO;
		}
		if (header_valid(&h) && h.done == WAITING) {
			if (h.len < len &&
			    flash_area_read(fa, tail * SLOT_SIZE + sizeof(h), buf, h.len) == 0 &&
			    crc32_ieee((const uint8_t *)buf, h.len) == h.crc) {
				buf[h.len] = '\0';
				k_mutex_unlock(&lock);
				return h.len;
			}
			LOG_WRN("Slot %u is corrupt, skipping it", tail);
			mark_done(tail);
			waiting--;
		}
		tail = next_slot(tail);
	}
	waiting = 0;
	tail = head;
	k_mutex_unlock(&lock);
	return -ENOENT;
}

void store_pop(void)
{
	k_mutex_lock(&lock, K_FOREVER);
	if (waiting > 0) {
		mark_done(tail);
		waiting--;
		tail = next_slot(tail);
	}
	k_mutex_unlock(&lock);
}

int store_count(void)
{
	return waiting;
}

int store_free(void)
{
	/* Up to a sector each is lost to partly used sectors at the head and the tail */
	int free = (int)slot_count - (int)waiting - 2 * SLOTS_PER_SECTOR;

	return MAX(free, 0);
}
```

## src/store.h
```c
/*
 * Upload queue items kept in the external W25Q64 flash, so they survive resets, power loss and
 * long LTE outages. Items come out in the order they went in.
 */

#pragma once

#include <stddef.h>

/* Finds the waiting items left from before the reset. 0, or a negative error without flash. */
int store_init(void);

/* Appends one NUL-terminated item. 0, -ENOMEM when full, or -EIO. */
int store_put(const char *item);

/* Copies the oldest waiting item into buf (NUL-terminated). Its length, or -ENOENT if none. */
int store_peek(char *buf, size_t len);

/* Marks the item returned by the last store_peek() as uploaded */
void store_pop(void);

/* Items waiting, and items that can still be added */
int store_count(void);
int store_free(void);
```

## src/tag_client.h
```c
/*
 * C10 tag download over BLE, following the ESP32-S3 hub (ble_client_service.c, dhruvaBle.cpp):
 *  0. advertise the hub beacon (Eddystone-UID, namespace AAAABBBBCCCCDDDDAAAA); a tag that hears it
 *     and has records opens its download server and advertises CONFIG_HUB_TAG_NAME ("exactcomms_tag")
 *  1. scan; a tag advertising CONFIG_HUB_TAG_NAME with RSSI >= CONFIG_HUB_TAG_MIN_RSSI is connected
 *  2. MTU exchange, discover service 0x010B: handshake 0x1401, data 0x1402 (config 0x1403 unused)
 *  3. enable indications on handshake, then data (the tag indicates, it does not notify)
 *  4. write the hub's free record count (uint16) to the handshake char
 *  5. the tag notifies its handshake; the hub writes 2 (start) to the data char
 *  6. each data indication becomes one upload queue item; the tag disconnects when done
 */

#pragma once

#include <stdbool.h>

/* Starts scanning for tags. Call once BLE is enabled and the clock is set. */
int tag_client_start(void);

/* A tag is connected or being connected */
bool tag_client_busy(void);
```

## src/tag_format.c
```c
#include <errno.h>
#include <stdio.h>
#include <stdlib.h>
#include <string.h>
#include <zephyr/logging/log.h>

#include "clock.h"
#include "tag_format.h"

LOG_MODULE_REGISTER(tag_format, LOG_LEVEL_INF);

struct tag_record {
	char data[TAG_RECORD_STRING_SIZE];
	char end_data[TAG_RECORD_STRING_SIZE];
};

static struct tag_record records[TAG_RECORDS_PER_PACKET];

/* Contact time = now - delta, as get_date_time_str_from_unit32_t() on the ESP32 hub */
static void format_contact_time(uint32_t delta_ms, char *buf, size_t len)
{
	clock_format_datetime(clock_now_utc() - delta_ms / 1000, buf, len);
}

/* Tag uptime as "d:hh:mm:ss", as get_time_str_from_long_s() on the ESP32 hub */
static void format_uptime(int64_t ms, char *buf, size_t len)
{
	if (ms < 0) {
		snprintf(buf, len, "Invalid time");
		return;
	}
	int64_t s = ms / 1000;

	snprintf(buf, len, "%lld:%02lld:%02lld:%02lld", s / 86400, (s / 3600) % 24, (s / 60) % 60,
		 s % 60);
}

int tag_parse_handshake(char *text, struct tag_handshake *hs)
{
	char *save;

	if (strchr(text, '|') == NULL) {
		return -EINVAL;
	}
	memset(hs, 0, sizeof(*hs));

	char *item = strtok_r(text, "|", &save);

	for (int i = 0; i < 4 && item != NULL; i++) {
		switch (i) {
		case 0:
			strncpy(hs->mac, item, sizeof(hs->mac) - 1);
			break;
		case 1:
			strncpy(hs->firmware, item, TAG_FIRMWARE_SIZE);
			break;
		case 2:
			hs->battery = (int16_t)strtol(item, NULL, 16);
			break;
		default:
			hs->uptime_ms = strtoll(item, NULL, 16);
			break;
		}
		item = strtok_r(NULL, "|", &save);
	}
	return 0;
}

static void parse_record(char *item, const struct tag_handshake *hs, struct tag_record *rec)
{
	char *save;
	int8_t rssi = 0;
	char beacon[TAG_MAC_SIZE] = "";
	uint32_t start_delta = 0;
	uint32_t end_delta = 0;

	/* "<idx>-<rssi>|<beacon>|<start>|<end>": the index is not uploaded */
	strtok_r(item, "-", &save);
	char *fields = strtok_r(NULL, "-", &save);
	char *field = (fields != NULL) ? strtok_r(fields, "|", &save) : NULL;

	for (int i = 0; i < 4 && field != NULL; i++) {
		switch (i) {
		case 0:
			rssi = (int8_t)strtol(field, NULL, 16);
			break;
		case 1:
			strncpy(beacon, field, sizeof(beacon) - 1);
			break;
		case 2:
			start_delta = (uint32_t)strtoul(field, NULL, 16);
			break;
		default:
			end_delta = (uint32_t)strtoul(field, NULL, 16);
			break;
		}
		field = strtok_r(NULL, "|", &save);
	}

	char start[24];
	char end[24];
	char uptime[32];

	format_contact_time(start_delta, start, sizeof(start));
	format_contact_time(end_delta, end, sizeof(end));
	format_uptime(hs->uptime_ms, uptime, sizeof(uptime));

	if (IS_ENABLED(CONFIG_HUB_LOG_RECORDS)) {
		LOG_INF("Record tag %s beacon %s rssi %d start %s end %s", hs->mac, beacon, rssi,
			start, end);
	}

	snprintf(rec->data, sizeof(rec->data), "%d|%d|%s|%s|%s|%s|%s", rssi, hs->battery, beacon,
		 hs->mac, hs->firmware, start, uptime);
	snprintf(rec->end_data, sizeof(rec->end_data), "%d|%d|%s|%s|%s|%s|%s", rssi, hs->battery,
		 beacon, hs->mac, hs->firmware, end, uptime);
}

int tag_format_data_packet(char *text, const struct tag_handshake *hs, char *out, size_t out_len)
{
	char *save;
	char *items[TAG_RECORDS_PER_PACKET];
	int count = 0;

	if (strchr(text, '-') == NULL) {
		return -EINVAL;
	}
	memset(records, 0, sizeof(records));

	char *total_str = strtok_r(text, "^", &save);
	int total = (total_str != NULL) ? (int)strtol(total_str, NULL, 16) : 0;
	char *list = strtok_r(NULL, "^", &save);
	char *item = (list != NULL) ? strtok_r(list, ",", &save) : NULL;

	while (item != NULL && count < total && count < TAG_RECORDS_PER_PACKET) {
		items[count++] = item;
		item = strtok_r(NULL, ",", &save);
	}
	for (int i = 0; i < count; i++) {
		parse_record(items[i], hs, &records[i]);
	}

	/* Always 8 fields, empty for missing records, exactly as the ESP32 hub queues them */
	snprintf(out, out_len, "%s,%s,%s,%s,%s,%s,%s,%s", records[0].data, records[0].end_data,
		 records[1].data, records[1].end_data, records[2].data, records[2].end_data,
		 records[3].data, records[3].end_data);
	return count;
}
```

## src/tag_format.h
```c
/*
 * C10 tag data parsing and the upload string format. Ported from the ESP32-S3 hub
 * (dhruvaBle.cpp, ble_proxy_utils) so the server receives exactly the same strings.
 *
 * Handshake notification:  "<tag mac>|<fw>|<battery mV hex>|<uptime ms hex>"
 * Data notification:       "<count hex>^<idx hex>-<rssi hex>|<beacon mac>|<start delta ms hex>|<end delta ms hex>,..."
 * Each record becomes two upload strings (contact start and end):
 *   "<rssi>|<battery>|<beacon mac>|<tag mac>|<fw>|<YYYY-mm-dd HH:MM:SS>|<tag uptime d:hh:mm:ss>"
 * and one queue item is the 8 strings of 4 records joined with ','.
 */

#pragma once

#include <stddef.h>
#include <stdint.h>

#define TAG_MAC_SIZE		 18
#define TAG_FIRMWARE_SIZE	 20
#define TAG_RECORDS_PER_PACKET	 4
#define TAG_PACKET_SIZE		 400

/*
 * Longest upload string: rssi (4) + battery (6) + beacon and tag MACs (17 each) + firmware (20)
 * + date (23, its buffer size) + tag uptime (31, its buffer size) + 6 '|' = 124 characters.
 * A queue item is 8 of them, 7 commas and the terminator.
 */
#define TAG_RECORD_STRING_SIZE	 125
#define TAG_QUEUE_ITEM_SIZE	 (TAG_RECORD_STRING_SIZE * 8)

struct tag_handshake {
	char mac[TAG_MAC_SIZE];
	int16_t battery;
	char firmware[TAG_FIRMWARE_SIZE + 1];
	int64_t uptime_ms;
};

/* Parses a handshake notification in place. Returns 0, or -EINVAL if it has no '|'. */
int tag_parse_handshake(char *text, struct tag_handshake *hs);

/*
 * Parses a data notification in place and writes the queue item into out.
 * Returns the number of records (0..4), or -EINVAL for a packet without records.
 */
int tag_format_data_packet(char *text, const struct tag_handshake *hs, char *out, size_t out_len);
```

## src/upload.c
```c
#include <errno.h>
#include <stdio.h>
#include <string.h>
#include <zephyr/kernel.h>
#include <zephyr/logging/log.h>
#include <nrf.h>

#include "clock.h"
#include "modem.h"
#include "store.h"
#include "tag_format.h"
#include "upload.h"

LOG_MODULE_REGISTER(upload, LOG_LEVEL_INF);

/* New items land here; with the flash queue on, the store thread moves them into flash */
K_MSGQ_DEFINE(upload_queue, TAG_QUEUE_ITEM_SIZE, CONFIG_HUB_QUEUE_SIZE, 4);

static bool flash_queue;
static K_THREAD_STACK_DEFINE(store_stack, 1536);
static struct k_thread store_thread;

enum server { MAIN_SERVER, AZ2_SERVER, AZ3_SERVER };

static const char *const servers[] = {
	[MAIN_SERVER] = CONFIG_HUB_SERVER_MAIN,
	[AZ2_SERVER] = CONFIG_HUB_SERVER_AZ2,
	[AZ3_SERVER] = CONFIG_HUB_SERVER_AZ3,
};

static enum server current_server = MAIN_SERVER;
static int64_t backup_since_ms;
static int retry_attempts;
static uint32_t ok_count;
static uint32_t fail_count;
static char hub_id[18] = "00:00:00:00:00:00";
static uint32_t boot_reset_reason;

/* One extra byte for the optional newline and one for the terminator */
static char item[TAG_QUEUE_ITEM_SIZE + 2];

void upload_set_hub_id(const char *mac)
{
	strncpy(hub_id, mac, sizeof(hub_id) - 1);
}

int upload_queue_put(const char *data)
{
	static char buf[TAG_QUEUE_ITEM_SIZE];

	strncpy(buf, data, sizeof(buf) - 1);
	buf[sizeof(buf) - 1] = '\0';
	if (k_msgq_put(&upload_queue, buf, K_NO_WAIT) != 0) {
		LOG_ERR("Upload queue full, dropping an item");
		return -ENOMEM;
	}
	return 0;
}

/* Moves items from RAM to flash, oldest first. Flash erases (~55 ms) stay out of the BLE thread. */
static void store_loop(void *p1, void *p2, void *p3)
{
	static char buf[TAG_QUEUE_ITEM_SIZE];

	for (;;) {
		k_msgq_get(&upload_queue, buf, K_FOREVER);
		int err;

		while ((err = store_put(buf)) != 0) {
			LOG_WRN("Flash queue %s, retrying", err == -ENOMEM ? "full" : "write failed");
			k_sleep(K_SECONDS(10));
		}
	}
}

void upload_init(void)
{
	if (!IS_ENABLED(CONFIG_HUB_FLASH_QUEUE) || store_init() != 0) {
		LOG_WRN("Upload queue in RAM only (%d items)", CONFIG_HUB_QUEUE_SIZE);
		return;
	}
	flash_queue = true;
	k_thread_create(&store_thread, store_stack, K_THREAD_STACK_SIZEOF(store_stack), store_loop,
			NULL, NULL, NULL, K_PRIO_PREEMPT(5), 0, K_NO_WAIT);
	k_thread_name_set(&store_thread, "store");
}

int upload_free_records(void)
{
	int items = k_msgq_num_free_get(&upload_queue);

	if (flash_queue) {
		items = MIN(items, store_free() - (int)k_msgq_num_used_get(&upload_queue));
	}
	return MAX(items, 0) * TAG_RECORDS_PER_PACKET;
}

int upload_items_waiting(void)
{
	return k_msgq_num_used_get(&upload_queue) + (flash_queue ? store_count() : 0);
}

bool upload_last_sync_ok(void)
{
	return retry_attempts == 0;
}

static void record_failure(void)
{
	fail_count++;
	retry_attempts++;
	if (retry_attempts <= CONFIG_HUB_SERVER_MAX_RETRIES) {
		return;
	}
	retry_attempts = 1;
	if (current_server == MAIN_SERVER) {
		current_server = AZ2_SERVER;
		backup_since_ms = k_uptime_get();
	} else if (current_server == AZ2_SERVER) {
		current_server = AZ3_SERVER;
		backup_since_ms = k_uptime_get();
	} else {
		current_server = MAIN_SERVER;
		backup_since_ms = 0;
	}
	LOG_WRN("Too many failures, switching to server %s", servers[current_server]);
}

void upload_process(void)
{
	if (flash_queue ? store_peek(item, TAG_QUEUE_ITEM_SIZE) < 0
			: k_msgq_peek(&upload_queue, item) != 0) {
		return;
	}

	if (backup_since_ms != 0 &&
	    k_uptime_get() - backup_since_ms > CONFIG_HUB_MAIN_SERVER_RETRY_MIN * 60 * 1000LL) {
		LOG_INF("Trying the main server again");
		current_server = MAIN_SERVER;
		backup_since_ms = 0;
	}

	const char *host = servers[current_server];
	size_t len = strlen(item);

	if (IS_ENABLED(CONFIG_HUB_UPLOAD_APPEND_NEWLINE)) {
		item[len++] = '\n';
		item[len] = '\0';
	}

	LOG_INF("Uploading %u bytes to %s:%d (%d waiting)", len, host, CONFIG_HUB_SERVER_PORT,
		upload_items_waiting());

	int err = modem_tcp_open(host, CONFIG_HUB_SERVER_PORT);

	if (err == 0) {
		err = modem_tcp_send(item, len);
	}
	if (err == 0) {
		int n = modem_tcp_wait_reply(CONFIG_HUB_ACK_TIMEOUT_S * 1000);

		err = (n > 0) ? 0 : (n == 0 ? -ETIMEDOUT : n);
	}
	modem_tcp_close();

	if (err == 0) {
		if (flash_queue) {
			store_pop();
		} else {
			k_msgq_get(&upload_queue, item, K_NO_WAIT);
		}
		ok_count++;
		retry_attempts = 0;
		LOG_INF("ACK OK (ok %u, failed %u)", ok_count, fail_count);
	} else {
		record_failure();
		LOG_WRN("Upload failed (%d), item kept (ok %u, failed %u, retry %d)", err, ok_count,
			fail_count, retry_attempts);
	}
}

static const char *reset_reason(uint32_t r)
{
	if (r & POWER_RESETREAS_RESETPIN_Msk) {
		return "Reset by external pin";
	}
	if (r & POWER_RESETREAS_DOG_Msk) {
		return "Reset due to watchdog";
	}
	if (r & POWER_RESETREAS_SREQ_Msk) {
		return "Software reset";
	}
	if (r & POWER_RESETREAS_LOCKUP_Msk) {
		return "Reset due to CPU lockup";
	}
	if (r & (POWER_RESETREAS_DIF_Msk | POWER_RESETREAS_OFF_Msk)) {
		return "Reset from debugger or wake-up";
	}
	return "Reset due to power-on event";
}

void upload_set_reset_reason(uint32_t resetreas)
{
	boot_reset_reason = resetreas;
}

void upload_queue_status_ping(int signal_dbm)
{
	char now[24];
	char ping[TAG_QUEUE_ITEM_SIZE];

	clock_format_datetime(clock_now_utc(), now, sizeof(now));

	/* Uptime as "h:m:s.ms", like get_time_str_from_long() on the ESP32 hub */
	int64_t ms = k_uptime_get();
	char uptime[32];

	snprintf(uptime, sizeof(uptime), "%lld:%lld:%lld.%lld", ms / 3600000, (ms / 60000) % 60,
		 (ms / 1000) % 60, ms % 1000);

	snprintf(ping, sizeof(ping), "%s|%s|%s|%s|%s|%u|%u|%d", CONFIG_HUB_VERSION, hub_id, now,
		 uptime, reset_reason(boot_reset_reason), ok_count, fail_count, signal_dbm);
	LOG_INF("Status ping: %s", ping);

	if (upload_queue_put(ping) == 0) {
		ok_count = 0;
		fail_count = 0;
	}
}
```
